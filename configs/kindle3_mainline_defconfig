## configs/kindle3_mainline_defconfig
```kconfig
BR2_arm=y
BR2_arm1136jf_s=y
BR2_TOOLCHAIN_BUILDROOT_VENDOR="paper"
BR2_TOOLCHAIN_BUILDROOT_MUSL=y
BR2_KERNEL_HEADERS_7_0=y
BR2_GCC_VERSION_15_X=y
BR2_OPTIMIZE_S=y
BR2_GLOBAL_PATCH_DIR="$(BR2_EXTERNAL_paper_linux_PATH)/patches/common $(BR2_EXTERNAL_paper_linux_PATH)/board/amazon/kindle3/common/patches $(BR2_EXTERNAL_paper_linux_PATH)/board/amazon/kindle3/mainline/patches"
BR2_TARGET_GENERIC_HOSTNAME="paper"
BR2_TARGET_GENERIC_ISSUE="Welcome to Paper Linux"
BR2_ROOTFS_DEVICE_CREATION_DYNAMIC_MDEV=y
BR2_ROOTFS_MERGED_USR=y
BR2_ROOTFS_MERGED_BIN=y
BR2_TARGET_GENERIC_GETTY_PORT="ttyGS0"
BR2_TARGET_GENERIC_GETTY_TERM="vt220"
BR2_ROOTFS_OVERLAY="$(BR2_EXTERNAL_paper_linux_PATH)/board/amazon/kindle3/mainline/rootfs-overlay"
BR2_LINUX_KERNEL=y
BR2_LINUX_KERNEL_DEFCONFIG="imx_v6_v7"
BR2_LINUX_KERNEL_CONFIG_FRAGMENT_FILES="$(BR2_EXTERNAL_paper_linux_PATH)/board/amazon/kindle3/mainline/linux.fragment"
BR2_LINUX_KERNEL_DTS_SUPPORT=y
BR2_LINUX_KERNEL_INTREE_DTS_NAME="nxp/imx/imx35-kindle3"
BR2_LINUX_KERNEL_CUSTOM_DTS_DIR="$(BR2_EXTERNAL_paper_linux_PATH)/board/amazon/kindle3/mainline/linux-dts"
BR2_PACKAGE_BUSYBOX_CONFIG="$(BR2_EXTERNAL_paper_linux_PATH)/board/paper/common/busybox.config"
BR2_PACKAGE_EVTEST=y
BR2_PACKAGE_DROPBEAR=y
# BR2_PACKAGE_DROPBEAR_CLIENT is not set
BR2_PACKAGE_DROPBEAR_DISABLE_REVERSEDNS=y
BR2_PACKAGE_FILE=y
BR2_PACKAGE_NANO=y
BR2_TARGET_ROOTFS_CPIO_GZIP=y
BR2_TARGET_ROOTFS_INITRAMFS=y
# BR2_TARGET_ROOTFS_TAR is not set
BR2_TARGET_BAREBOX=y
BR2_TARGET_BAREBOX_CUSTOM_VERSION=y
BR2_TARGET_BAREBOX_CUSTOM_VERSION_VALUE="2019.10.0"
BR2_TARGET_BAREBOX_NEEDS_LIBUSB=y
BR2_TARGET_BAREBOX_BOARD_DEFCONFIG="kindle3"
BR2_TARGET_BAREBOX_CONFIG_FRAGMENT_FILES="$(BR2_EXTERNAL_paper_linux_PATH)/board/amazon/kindle3/mainline/barebox.fragment"
BR2_TARGET_BAREBOX_IMAGE_FILE="barebox.imximg"
BR2_TARGET_BAREBOX_BAREBOXENV=y
```

## package/atheros-ar6k-tools/Config.in
```kconfig
config BR2_PACKAGE_ATHEROS_AR6K_TOOLS
	bool "atheros-ar6k-tools"
	help
	  Atheros AR6000-series vendor utilities for bootstrapping and
	  controlling AR6K Wi-Fi devices. This installs bmiloader, eeprom,
	  wmiconfig, and recEvent from the GPLv2 Atheros AR6K SDK.

	  Firmware and board calibration data are not included.

	  https://chromium.googlesource.com/chromiumos/third_party/atheros/
```
