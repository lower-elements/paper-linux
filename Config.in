## Config.in
```kconfig
source "$BR2_EXTERNAL_paper_linux_PATH/package/espeak-ng/Config.in"
source "$BR2_EXTERNAL_paper_linux_PATH/package/pcaudiolib/Config.in"
source "$BR2_EXTERNAL_paper_linux_PATH/package/libsonic/Config.in"
source "$BR2_EXTERNAL_paper_linux_PATH/package/fbink/Config.in"
```

## configs/kindle_k3w_defconfig
```kconfig
BR2_arm=y
BR2_arm1136jf_s=y
BR2_TOOLCHAIN_BUILDROOT_VENDOR="paper"
BR2_TOOLCHAIN_BUILDROOT_MUSL=y
BR2_KERNEL_HEADERS_CUSTOM_GIT=y
BR2_KERNEL_HEADERS_CUSTOM_REPO_URL="https://github.com/katadelos/linux-2.6.26-lab126"
BR2_KERNEL_HEADERS_CUSTOM_REPO_VERSION="master"
BR2_TOOLCHAIN_BUILDROOT_CXX=y
BR2_GLOBAL_PATCH_DIR="$(BR2_EXTERNAL_paper_linux_PATH)/patches"
BR2_TARGET_GENERIC_HOSTNAME="paper"
BR2_TARGET_GENERIC_ISSUE="Welcome to Paper Linux"
BR2_ROOTFS_DEVICE_CREATION_STATIC=y
BR2_ROOTFS_MERGED_USR=y
BR2_TARGET_GENERIC_ROOT_PASSWD="paper"
BR2_SYSTEM_ENABLE_NLS=y
BR2_TARGET_TZ_INFO=y
BR2_ROOTFS_OVERLAY="$(BR2_EXTERNAL_paper_linux_PATH)/board/kindle/k3w/rootfs_overlay"
BR2_PACKAGE_BUSYBOX_CONFIG="$(BR2_EXTERNAL_paper_linux_PATH)/configs/busybox.config"
BR2_PACKAGE_BUSYBOX_WATCHDOG=y
BR2_PACKAGE_ALSA_UTILS=y
BR2_PACKAGE_ALSA_UTILS_ALSAUCM=y
BR2_PACKAGE_ALSA_UTILS_AMIXER=y
BR2_PACKAGE_ALSA_UTILS_APLAY=y
# BR2_PACKAGE_ALSA_LIB_TOPOLOGY is not set
BR2_PACKAGE_CA_CERTIFICATES=y
BR2_PACKAGE_OPENSSL=y
BR2_PACKAGE_LIBOPENSSL_BIN=y
# BR2_PACKAGE_LIBOPENSSL_ENABLE_LOADER_ENGINE is not set
BR2_PACKAGE_FREETYPE=y
BR2_PACKAGE_HARFBUZZ=y
BR2_PACKAGE_C_ARES=y
BR2_PACKAGE_LIBCURL=y
BR2_PACKAGE_LIBCURL_CURL=y
BR2_PACKAGE_LIBCURL_VERBOSE=y
BR2_PACKAGE_DROPBEAR=y
# BR2_PACKAGE_DROPBEAR_SMALL is not set
BR2_PACKAGE_DROPBEAR_LASTLOG=y
BR2_PACKAGE_WIRELESS_TOOLS=y
BR2_PACKAGE_WIRELESS_TOOLS_LIB=y
BR2_PACKAGE_WPA_SUPPLICANT=y
# BR2_PACKAGE_WPA_SUPPLICANT_NL80211 is not set
BR2_PACKAGE_WPA_SUPPLICANT_WEXT=y
BR2_PACKAGE_WPA_SUPPLICANT_CLI=y
BR2_PACKAGE_WPA_SUPPLICANT_WPA_CLIENT_SO=y
BR2_PACKAGE_WPA_SUPPLICANT_PASSPHRASE=y
BR2_PACKAGE_FILE=y
BR2_PACKAGE_NANO=y
# BR2_PACKAGE_NANO_TINY is not set
BR2_TARGET_ROOTFS_EXT2=y
BR2_TARGET_ROOTFS_EXT2_3=y
BR2_TARGET_ROOTFS_EXT2_LABEL="paper"
BR2_TARGET_ROOTFS_EXT2_SIZE="100M"
BR2_PACKAGE_HOST_KMOD=y
BR2_PACKAGE_HOST_UBOOT_TOOLS=y
BR2_PACKAGE_ESPEAK_NG=y
BR2_PACKAGE_ESPEAK_NG_MBROLA=y
BR2_PACKAGE_PCAUDIOLIB=y
BR2_PACKAGE_LIBSONIC=y
BR2_PACKAGE_FBINK=y
BR2_PACKAGE_FBINK_PLATFORM_KINDLE=y
BR2_PACKAGE_FBINK_FONTS=y
BR2_PACKAGE_FBINK_IMAGE=y
BR2_PACKAGE_FBINK_OPENTYPE=y
BR2_PACKAGE_FBINK_INPUT=y
BR2_PACKAGE_DIRECTFB2=y
BR2_PACKAGE_DIRECTFB2_FBDEV=y
BR2_PACKAGE_DIRECTFB2_LINUXINPUT=y
```

## package/directfb2/Config.in
```kconfig
config BR2_PACKAGE_DIRECTFB2
	bool "directfb2"
	depends on BR2_TOOLCHAIN_HAS_THREADS
	help
	  DirectFB2 graphics and windowing library.

if BR2_PACKAGE_DIRECTFB2

menu "System modules"

config BR2_PACKAGE_DIRECTFB2_FBDEV
	bool "fbdev backend"
	default n
	help
	  Enable the Linux FBDev system module.

endmenu

menu "Input modules"

config BR2_PACKAGE_DIRECTFB2_LINUXINPUT
	bool "linux_input input driver"
	default n
	help
	  Enable the linux_input input driver (evdev).

endmenu

config BR2_PACKAGE_DIRECTFB2_TEXT
	bool "text"
	default n
	depends on BR2_PACKAGE_FREETYPE
	depends on BR2_PACKAGE_HARFBUZZ
	help
	  Enable DirectFB2 text output support.

endif
```

## package/emacs/Config.in
```kconfig
config BR2_PACKAGE_EMACS
	bool "emacs"
	depends on BR2_USE_MMU
	depends on BR2_USE_WCHAR
	select BR2_PACKAGE_NCURSES
	select BR2_PACKAGE_NCURSES_WCHAR
	help
	  GNU Emacs text editor (terminal-only build).

	  This package is configured for a small TUI-only install with
	  optional feature toggles for extra runtime capabilities.

	  https://www.gnu.org/software/emacs/

if BR2_PACKAGE_EMACS

config BR2_PACKAGE_EMACS_ZLIB
	bool "zlib support"
	default n
	select BR2_PACKAGE_ZLIB
	help
	  Enable compressed file support.

config BR2_PACKAGE_EMACS_GNUTLS
	bool "GnuTLS support"
	default n
	select BR2_PACKAGE_GNUTLS
	help
	  Enable TLS support for HTTPS and package downloads.

config BR2_PACKAGE_EMACS_XML2
	bool "libxml2 support"
	default n
	select BR2_PACKAGE_LIBXML2
	help
	  Enable XML parsing support via libxml2.

config BR2_PACKAGE_EMACS_SQLITE3
	bool "sqlite3 support"
	default n
	select BR2_PACKAGE_SQLITE
	help
	  Enable sqlite3-backed features.

endif

comment "emacs needs a toolchain with MMU and wchar"
	depends on !BR2_USE_MMU || !BR2_USE_WCHAR
```

## package/espeak-ng/Config.in
```kconfig
config BR2_PACKAGE_ESPEAK_NG
	bool "espeak-ng"
	help
	  eSpeak NG text-to-speech engine.

	  https://github.com/espeak-ng/espeak-ng

if BR2_PACKAGE_ESPEAK_NG

config BR2_PACKAGE_ESPEAK_NG_SPEECH_PLAYER
	bool "speech-player"
	default y
	help
	  Enable the speechPlayer Klatt implementation.

config BR2_PACKAGE_ESPEAK_NG_KLATT
	bool "klatt"
	default y
	help
	  Enable the Klatt formant synthesizer.

config BR2_PACKAGE_ESPEAK_NG_ASYNC
	bool "async"
	default y
	help
	  Enable asynchronous synthesis.

config BR2_PACKAGE_ESPEAK_NG_EXTDICT_RU
	bool "extdict-ru"
	default y
	help
	  Enable the Russian extended dictionary.

config BR2_PACKAGE_ESPEAK_NG_EXTDICT_CMN
	bool "extdict-cmn"
	default y
	help
	  Enable the Mandarin extended dictionary.

config BR2_PACKAGE_ESPEAK_NG_EXTDICT_YUE
	bool "extdict-yue"
	default y
	help
	  Enable the Cantonese extended dictionary.

config BR2_PACKAGE_ESPEAK_NG_MBROLA
	bool "mbrola"
	default n
	help
	  Enable the MBROLA speech synthesizer.

endif
```

## package/fbink/Config.in
```kconfig
config BR2_PACKAGE_FBINK
	bool "fbink"
	help
	  FrameBuffer eInker library and CLI for e-ink devices.

	  https://github.com/NiLuJe/FBInk

if BR2_PACKAGE_FBINK

choice
	prompt "FBInk platform"
	default BR2_PACKAGE_FBINK_PLATFORM_LINUX
	help
	  Select the device family FBInk should target.

config BR2_PACKAGE_FBINK_PLATFORM_KINDLE
	bool "Kindle"
	help
	  Amazon Kindle e-ink devices.

config BR2_PACKAGE_FBINK_PLATFORM_KOBO
	bool "Kobo"
	help
	  Rakuten Kobo e-ink devices.

config BR2_PACKAGE_FBINK_PLATFORM_CERVANTES
	bool "Cervantes"
	help
	  BQ Cervantes e-ink devices.

config BR2_PACKAGE_FBINK_PLATFORM_REMARKABLE
	bool "reMarkable"
	help
	  reMarkable e-ink tablets.

config BR2_PACKAGE_FBINK_PLATFORM_POCKETBOOK
	bool "PocketBook"
	help
	  PocketBook e-ink devices.

config BR2_PACKAGE_FBINK_PLATFORM_LINUX
	bool "Linux (generic)"
	help
	  Generic Linux framebuffer devices.

endchoice

config BR2_PACKAGE_FBINK_DRAW
	bool "draw support"
	default n
	help
	  Enable drawing primitives.

config BR2_PACKAGE_FBINK_FONTS
	bool "extra bitmap fonts"
	default n
	select BR2_PACKAGE_FBINK_DRAW
	help
	  Bundle the extra fixed-cell bitmap fonts.

config BR2_PACKAGE_FBINK_IMAGE
	bool "image support"
	default n
	select BR2_PACKAGE_STB
	select BR2_PACKAGE_FBINK_DRAW
	help
	  Enable image rendering support.
	  Requires stb.

config BR2_PACKAGE_FBINK_OPENTYPE
	bool "OpenType/TrueType support"
	default n
	select BR2_PACKAGE_STB
	select BR2_PACKAGE_LIBUNIBREAK
	select BR2_PACKAGE_FBINK_DRAW
	help
	  Enable OpenType/TrueType font rendering.
	  Requires stb and libunibreak.

config BR2_PACKAGE_FBINK_INPUT
	bool "input support"
	default n
	help
	  Enable input utilities and input scan support.

endif
```

## package/libsonic/Config.in
```kconfig
config BR2_PACKAGE_LIBSONIC
	bool "libsonic"
	help
	  Simple C library for speeding up or slowing down speech.

	  https://github.com/espeak-ng/sonic
```

## package/pcaudiolib/Config.in
```kconfig
config BR2_PACKAGE_PCAUDIOLIB
	bool "pcaudiolib"
	depends on BR2_PACKAGE_ALSA_LIB
	help
	  Portable C audio library.

	  https://github.com/espeak-ng/pcaudiolib
```
